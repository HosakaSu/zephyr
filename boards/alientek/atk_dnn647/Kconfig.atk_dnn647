## boards/alientek/atk_dnn647/Kconfig.atk_dnn647
```kconfig
# SPDX-FileCopyrightText: Copyright The Zephyr Project Contributors
# SPDX-License-Identifier: Apache-2.0

config BOARD_ATK_DNN647
	select SOC_STM32N647XX
```

## boards/alientek/atk_dnn647/atk_dnn647_defconfig
```kconfig
# SPDX-FileCopyrightText: Copyright The Zephyr Project Contributors
# SPDX-License-Identifier: Apache-2.0

CONFIG_SERIAL=y
CONFIG_CONSOLE=y
CONFIG_UART_CONSOLE=y
CONFIG_GPIO=y
CONFIG_ARM_MPU=y
CONFIG_HW_STACK_PROTECTION=y
CONFIG_XIP=n
CONFIG_TRUSTED_EXECUTION_SECURE=y
```

## boards/alientek/atk_dnn647/board.yml
```yaml
# SPDX-FileCopyrightText: Copyright The Zephyr Project Contributors
# SPDX-License-Identifier: Apache-2.0

board:
  name: atk_dnn647
  full_name: ALIENTEK ATK-DNN647
  vendor: alientek
  socs:
    - name: stm32n647xx
```

## boards/muselab/nano_ch32h417/Kconfig.nano_ch32h417
```kconfig
# Copyright (c) 2026 Liu Changjie
# SPDX-License-Identifier: Apache-2.0

config BOARD_NANO_CH32H417
	select SOC_CH32H417_V3F if BOARD_NANO_CH32H417_CH32H417_V3F
	select SOC_CH32H417_V5F if BOARD_NANO_CH32H417_CH32H417_V5F
```

## boards/muselab/nano_ch32h417/board.yml
```yaml
board:
  name: nano_ch32h417
  full_name: MuseLab nanoCH32H417
  vendor: muselab
  socs:
    - name: ch32h417
```

## drivers/input/Kconfig.gpio_rc_touch
```kconfig
# SPDX-FileCopyrightText: Copyright The Zephyr Project Contributors
# SPDX-License-Identifier: Apache-2.0

config INPUT_GPIO_RC_TOUCH
	bool "GPIO RC touch input driver"
	default y
	depends on DT_HAS_ZEPHYR_GPIO_RC_TOUCH_ENABLED
	depends on !SMP
	select GPIO
	select TIMING_FUNCTIONS
	help
	  Detect touch by measuring the charging time of a capacitive pad with
	  an external pull-up resistor. Requires a nonblocking on-chip GPIO
	  with simultaneous input and open-drain output, and a timing counter
	  running at least at 1 MHz. Interrupts are masked during each charge
	  measurement, for up to 100 microseconds plus GPIO access overhead.
	  Keep the pad untouched during the first 32 successful scans after boot.
```

## drivers/input/Kconfig.vs1838b
```kconfig
# Copyright (c) 2025 Bastien Jauny <bastien.jauny@smile.fr>
# SPDX-License-Identifier: Apache-2.0

config INPUT_VS1838B
	bool "Vishay VS1838B infrared receiver"
	default y
	depends on DT_HAS_VISHAY_VS1838B_ENABLED
	select INPUT_GPIO_IR_NEC
	help
	  This option enables the driver for the VS1838B infrared receiver.

config INPUT_GPIO_IR_RECEIVER
	bool "GPIO infrared receiver"
	default y
	depends on DT_HAS_GPIO_IR_RECEIVER_ENABLED
	select INPUT_GPIO_IR_NEC
	help
	  Decode standard NEC frames from a GPIO-connected infrared receiver.
	  Report the address and command as INPUT_MSC_SCAN events. Extended
	  addresses and repeat frames are not decoded.

config INPUT_GPIO_IR_NEC
	bool
	select GPIO
```

## drivers/pulse_io/Kconfig.stm32_timer
```kconfig
# SPDX-FileCopyrightText: Copyright The Zephyr Project Contributors
# SPDX-License-Identifier: Apache-2.0

config PULSE_IO_STM32_TIMER
	bool "STM32 timer Pulse IO driver"
	default y
	depends on DT_HAS_ST_STM32_TIMER_PULSE_IO_ENABLED
	depends on SOC_SERIES_STM32N6X
	select DMA
	select PINCTRL
	select RESET
	select CACHE_MANAGEMENT if DCACHE
	help
	  Generate fixed-period cells using a timer output-compare channel and
	  update-event DMA. Supports synchronous CELL-mode transmit with idle
	  low. The driver owns the whole timer; PWM and counter drivers cannot
	  use another channel of the same timer. RX, looping, carrier modulation
	  and RTIO are not supported. Currently supports STM32N6 GPDMA.
```

## drivers/sensor/liteon/ap3216c/Kconfig
```kconfig
# SPDX-FileCopyrightText: Copyright The Zephyr Project Contributors
# SPDX-License-Identifier: Apache-2.0

config AP3216C
	bool "LiteOn AP3216C ambient light and proximity sensor"
	default y
	depends on DT_HAS_LITEON_AP3216C_ENABLED
	select I2C
	help
	  Enable polling of ambient light, proximity and infrared data from
	  the AP3216C sensor. Interrupts and runtime gain changes are not supported.
```

## drivers/sensor/qst/Kconfig
```kconfig
# SPDX-FileCopyrightText: Copyright The Zephyr Project Contributors
# SPDX-License-Identifier: Apache-2.0

source "drivers/sensor/qst/qmc6308/Kconfig"
source "drivers/sensor/qst/qmi8658a/Kconfig"
```

## drivers/sensor/qst/qmc6308/Kconfig
```kconfig
# SPDX-FileCopyrightText: Copyright The Zephyr Project Contributors
# SPDX-License-Identifier: Apache-2.0

config QMC6308
	bool "QST QMC6308 three-axis magnetometer"
	default y
	depends on DT_HAS_QST_QMC6308_ENABLED
	select I2C
	help
	  Enable polling of magnetic field measurements from the QMC6308.
	  Measurements use the chip axes and are reported in gauss.
```

## dts/bindings/input/gpio-ir-receiver.yaml
```yaml
# SPDX-FileCopyrightText: Copyright The Zephyr Project Contributors
# SPDX-License-Identifier: Apache-2.0

description: GPIO-connected demodulating infrared receiver

compatible: "gpio-ir-receiver"

include: base.yaml

properties:
  gpios:
    type: phandle-array
    required: true
    description: GPIO carrying the demodulated infrared signal, usually active low.
```

## dts/bindings/input/zephyr,gpio-rc-touch.yaml
```yaml
# SPDX-FileCopyrightText: Copyright The Zephyr Project Contributors
# SPDX-License-Identifier: Apache-2.0

description: |
  Capacitive touch pad with a GPIO and an external pull-up resistor.

  The GPIO discharges the pad as an open-drain output, then releases it
  and measures the time until the input reads high. Touch increases this
  charge time. Requires a nonblocking on-chip GPIO supporting simultaneous
  input and open-drain output. GPIO expanders are not supported.

  The first 32 successful scans calibrate the untouched charge time.
  Keep the pad untouched during calibration. The baseline is fixed until
  reboot; changes in the external circuit or environment require calibration
  again. Three consecutive samples beyond a threshold change the key state.
  Timing includes GPIO access overhead and is not a capacitance measurement.

compatible: "zephyr,gpio-rc-touch"

include: base.yaml

properties:
  gpios:
    type: phandle-array
    required: true
    description: |
      Active-high pad GPIO with no internal pull-up or pull-down.
      The driver enables open-drain output and input simultaneously.
      The pad needs an external pull-up to a GPIO-compatible supply.

  zephyr,code:
    type: int
    required: true
    description: Input key code to report for touch and release.

  poll-interval-ms:
    type: int
    required: true
    description: |
      Delay between charge measurements, during which the pad is discharged.
      Must be at least 5 milliseconds and long enough for full discharge.

  press-threshold-percent:
    type: int
    required: true
    description: |
      Charge time as a percentage of the calibrated baseline to detect touch.
      Must be greater than release-threshold-percent and at most 1000.
      Select thresholds using measurements with the target circuit and build.

  release-threshold-percent:
    type: int
    required: true
    description: |
      Charge time as a percentage of the calibrated baseline at or below
      which a touched pad is released. Must be greater than 100 and below
      press-threshold-percent to provide hysteresis.
```

## dts/bindings/pulse-io/st,stm32-timer-pulse-io.yaml
```yaml
# SPDX-FileCopyrightText: Copyright The Zephyr Project Contributors
# SPDX-License-Identifier: Apache-2.0

description: |
  STM32 timer output-compare channel with update-event DMA for Pulse IO.

  This node is a child of an st,stm32-timers node and exclusively owns that
  timer. Disable all sibling PWM, counter and quadrature decoder nodes.
  Only CELL-mode transmit with idle low is supported. The single logical
  Pulse IO channel is numbered zero, independent of st,channel.

  DMA copies 16-bit duty values to the selected CCR register on timer update
  events. The transfer begins with one idle cell to prime the preload register
  and ends with an idle cell before completion. All cells have a fixed period;
  duty values from zero through the configured period are supported.

compatible: "st,stm32-timer-pulse-io"

include: [base.yaml, pulse-io-controller.yaml, pinctrl-device.yaml]

properties:
  st,channel:
    type: int
    required: true
    enum: [1, 2, 3, 4]
    description: Timer output-compare channel routed by pinctrl.

  dmas:
    required: true
    description: |
      One DMA channel using the parent timer update request, not the capture
      compare request. Transfers use 16-bit memory-to-peripheral accesses
      with incrementing source and fixed destination. The channel-config
      priority field selects DMA priority.

  dma-names:
    required: true
    const: [up]

  zephyr,max-cells:
    type: int
    required: true
    description: |
      Maximum cells per transmit request, from 1 to 32766. A static DMA
      buffer holds this many 16-bit duties plus two idle cells.

  "#pulse-io-cells":
    const: 1

pulse-io-cells:
  - channel
```

## dts/bindings/sensor/liteon,ap3216c.yaml
```yaml
# SPDX-FileCopyrightText: Copyright The Zephyr Project Contributors
# SPDX-License-Identifier: Apache-2.0

description: LiteOn AP3216C ambient light, proximity and infrared sensor

compatible: "liteon,ap3216c"

include: [sensor-device.yaml, i2c-device.yaml]

properties:
  als-gain:
    type: int
    default: 1
    enum: [1, 4, 16, 64]
    description: |
      Ambient light gain. The default corresponds to the register reset
      setting, which provides the widest illuminance range.
```

## dts/bindings/sensor/qst,qmc6308.yaml
```yaml
# SPDX-FileCopyrightText: Copyright The Zephyr Project Contributors
# SPDX-License-Identifier: Apache-2.0

description: QST QMC6308 three-axis magnetic field sensor

compatible: "qst,qmc6308"

include: [sensor-device.yaml, i2c-device.yaml]

properties:
  full-scale:
    type: int
    default: 30
    enum: [30, 12, 8, 2]
    description: |
      Full-scale magnetic field in gauss. The default matches the reset
      range and gives the widest measurement span.

  sampling-frequency:
    type: int
    default: 10
    enum: [10, 50, 100, 200]
    description: |
      Output data rate in Hz in normal measurement mode. The default
      matches the reset value of the output data rate field.
```

## samples/subsys/video/capture/Kconfig
```kconfig
# Copyright (c) 2024 Espressif Systems (Shanghai) Co., Ltd.
# SPDX-License-Identifier: Apache-2.0

mainmenu "Video capture sample application"

menu "Video capture configuration"

config VIDEO_SOURCE_CROP_LEFT
	int "Crop area left value"
	default 0
	help
	   Left value of the crop area within the video source.

config VIDEO_SOURCE_CROP_TOP
	int "Crop area top value"
	default 0
	help
	   Top value of the crop area within the video source.

config VIDEO_SOURCE_CROP_WIDTH
	int "Crop area width value"
	default 0
	help
	   Width value of the crop area within the video source.
	   If set to 0, the crop is not applied.

config VIDEO_SOURCE_CROP_HEIGHT
	int "Crop area height value"
	default 0
	help
	   Height value of the crop area within the video source.
	   If set to 0, the crop is not applied.

config VIDEO_FRAME_HEIGHT
	int "Height of the video frame"
	default 0
	help
	  Height of the video frame. If set to 0, the default height is used.

config VIDEO_FRAME_WIDTH
	int "Width of the video frame"
	default 0
	help
	  Width of the video frame. If set to 0, the default width is used.

config VIDEO_PIXEL_FORMAT
	string "Pixel format of the video frame"
	help
	  Pixel format of the video frame. If not set, the default pixel format is used.

config VIDEO_CTRL_HFLIP
	bool "Mirror the video frame horizontally"
	help
	  If set, mirror the video frame horizontally

config VIDEO_CTRL_VFLIP
	bool "Mirror the video frame vertically"
	help
	  If set, mirror the video frame vertically

config VIDEO_SHELL_AND_CAPTURE
	bool "Capture video even if the video shell is enabled"
	depends on VIDEO_SHELL
	default n
	help
	  If set, the video capture is enabled even if the video shell is also enabled.

menuconfig SAMPLE_IMX335_ISP
	bool "IMX335 black level, white balance and gamma processing"
	depends on VIDEO_STM32_DCMIPP && VIDEO_IMX335 && SOC_SERIES_STM32N6X
	help
	  Configure the DCMIPP image processing blocks for IMX335 RAW input.
	  Apply black level correction, fixed red/blue gains and gamma conversion.
	  This does not provide automatic exposure or automatic white balance.

if SAMPLE_IMX335_ISP

config SAMPLE_IMX335_SENSOR_GAIN
	int "Sensor gain in millidecibels"
	range 0 72000
	default 0
	help
	  Initial analogue gain, in multiples of 300 millidecibels. The video
	  shell can adjust this value while the capture is running.

config SAMPLE_IMX335_RED_GAIN
	int "Red channel gain in thousandths"
	range 125 8000
	default 1000
	help
	  Fixed red channel gain for the lighting conditions. 1000 means unity.
	  The green channel always uses unity gain.

config SAMPLE_IMX335_BLUE_GAIN
	int "Blue channel gain in thousandths"
	range 125 8000
	default 1000
	help
	  Fixed blue channel gain for the lighting conditions. 1000 means unity.

endif # SAMPLE_IMX335_ISP

config VIDEO_CAM_NUM_BUFS
	int "Number of video buffers used for the camera"
	default 2
	help
	  Number of buffers in the video buffer pool used for the camera device.
	  The rest of the buffer pool will be used for other purposes such as transformation.

choice VIDEO_TRANSFORM
	prompt "Video transform implementation"
	bool
	help
	  The captured frame will go through m2m transforms defined in a separate .c file.
	  The implementation could include "transform.h" which provides helper functions
	  for setting up and executing the transformation.

config VIDEO_TRANSFORM_NXP_JPEGDEC
	bool "Use NXP JPEG decoder for video transform"
	depends on VIDEO_MCUX_JPEGDEC
	help
	  Use NXP JPEG decoder to decompress JPEG frames

config VIDEO_TRANSFORM_NXP_PNGDEC
	bool "Use NXP PNG decoder for video transform"
	depends on VIDEO_MCUX_PNGDEC
	help
	  Use NXP PNG decoder to decompress PNG frames

endchoice

endmenu

source "Kconfig.zephyr"
```
