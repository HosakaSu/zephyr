## boards/wch/ch32h417evt/ch32h417evt_ch32h417_v3f_defconfig
```kconfig
# Copyright (c) 2026 Liu Changjie
# SPDX-License-Identifier: Apache-2.0

CONFIG_BOOT_BANNER=n
CONFIG_CLOCK_CONTROL=n
CONFIG_CONSOLE=n
CONFIG_PRINTK=n
CONFIG_SERIAL=n
CONFIG_SIZE_OPTIMIZATIONS=y

CONFIG_MAIN_STACK_SIZE=512
CONFIG_IDLE_STACK_SIZE=256
CONFIG_ISR_STACK_SIZE=512

CONFIG_RV_BOOT_HART=0
```

## drivers/ethernet/Kconfig.ch395
```kconfig
# WCH CH395 Ethernet controller configuration options

# Copyright (c) 2026 Liu Changjie <liucj1228@outlook.com>
# SPDX-License-Identifier: Apache-2.0

menuconfig ETH_CH395
	bool "WCH CH395 Ethernet Controller"
	default y
	depends on DT_HAS_WCH_CH395_ENABLED
	select GPIO
	select SPI
	help
	  WCH CH395 standalone Ethernet controller with SPI interface.

config ETH_CH395_RX_THREAD_STACK_SIZE
	int "Stack size for internal CH395 monitor thread"
	depends on ETH_CH395
	default 1024
	help
	  Size of the stack used for the internal CH395 monitor thread.

config ETH_CH395_RX_THREAD_PRIO
	int "Priority for internal CH395 monitor thread"
	depends on ETH_CH395
	default 2
	help
	  Priority level for the internal CH395 monitor thread.

config ETH_CH395_MONITOR_PERIOD
	int "CH395 monitor period in milliseconds"
	depends on ETH_CH395
	default 500
	help
	  Monitor period in milliseconds for detecting and reporting link
	  status changes to the network stack.

config ETH_CH395_PHY_LINK_TIMEOUT_MS
	int "Timeout in milliseconds for PHY link up during init"
	depends on ETH_CH395
	default 10000
	help
	  Maximum time to wait for the CH395 PHY to report link up during
	  driver initialization before opening the MACRAW socket. Both WCH
	  and GD32 reference implementations poll GET_PHY_STATUS until the
	  link is up before SET_PROTO_TYPE_SN and OPEN_SOCKET_SN. Set to 0
	  to skip the wait and open the socket immediately.
```

## dts/bindings/ethernet/wch,ch395.yaml
```yaml
# Copyright (c) 2026 Liu Changjie <liucj1228@outlook.com>
# SPDX-License-Identifier: Apache-2.0

description: WCH CH395 standalone Ethernet controller with SPI interface

compatible: "wch,ch395"

include: [spi-device.yaml, ethernet-controller.yaml]

properties:
  int-gpios:
    type: phandle-array
    required: true
    description: Interrupt pin.

      The CH395 interrupt pin is active low. If connected directly, the MCU pin
      should be configured as active low.

  reset-gpios:
    type: phandle-array
    required: true
    description: Reset pin.

      The CH395 reset pin is active low. If connected directly, the MCU pin
      should be configured as active low.
```

## dts/bindings/serial/gd,gd32-usart.yaml
```yaml
# Copyright (c) 2021, ATL Electronics
# SPDX-License-Identifier: Apache-2.0

description: GigaDevice USART

compatible: "gd,gd32-usart"

include: [uart-controller.yaml, reset-device.yaml, pinctrl-device.yaml]

properties:
  reg:
    required: true

  interrupts:
    required: true

  dmas:
    description: DMA channels for RX and TX

  dma-names:
    description: DMA channel names, expected to be "rx" and "tx"

  resets:
    required: true

  clocks:
    required: true
```

## samples/boards/jlc/skystar_gd32f407vet6/uart_dma_echo/sample.yaml
```yaml
sample:
  name: SkyStar GD32F407VET6 UART DMA echo
tests:
  sample.boards.jlc.skystar_gd32f407vet6.uart_dma_echo:
    platform_allow: skystar_gd32f407vet6
    harness: console
    harness_config:
      type: one_line
      regex:
        - "UART DMA echo ready"
    tags:
      - serial
      - dma
```

## soc/wch/ch32v/ch32h41x/Kconfig
```kconfig
# Copyright (c) 2026 Liu Changjie
# SPDX-License-Identifier: Apache-2.0

config SOC_SERIES_CH32H41X

config SOC_CH32H417_V3F
	# SOC_EARLY_INIT_HOOK is defined in kernel/Kconfig.init, which is not
	# loaded by the SoC-only Kconfig.soc.* compliance environment, so the
	# select must live in this (full-tree) Kconfig rather than Kconfig.soc.*.
	select SOC_EARLY_INIT_HOOK
```

## soc/wch/ch32v/ch32h41x/Kconfig.soc
```kconfig
# Copyright (c) 2026 Liu Changjie
# SPDX-License-Identifier: Apache-2.0

config SOC_SERIES_CH32H41X
	bool
	select SOC_FAMILY_CH32V

config SOC_SERIES
	default "ch32h41x" if SOC_SERIES_CH32H41X

rsource "Kconfig.soc.*"
```
