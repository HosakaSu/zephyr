/*
 * Copyright (c) 2026 Liu Changjie
 *
 * SPDX-License-Identifier: Apache-2.0
 */

#include <zephyr/dt-bindings/pinctrl/ch32h41x-pinctrl.h>

&pinctrl {
	usart1_default: usart1_default {
		tx_group {
			pinmux = <USART1_TX_PA9_AF7>;
			output-high;
			drive-push-pull;
			slew-rate = "max-speed-180mhz";
		};

		rx_group {
			pinmux = <USART1_RX_PA10_AF7>;
		};
	};
};
