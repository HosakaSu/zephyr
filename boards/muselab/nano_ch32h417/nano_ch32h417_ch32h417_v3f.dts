/*
 * Copyright (c) 2026 Liu Changjie
 *
 * SPDX-License-Identifier: Apache-2.0
 */

/dts-v1/;

#include <wch/ch32h417/ch32h417_v3f.dtsi>

/ {
	model = "MuseLab nanoCH32H417 V3F waker";
	compatible = "muselab,nano-ch32h417";

	chosen {
		zephyr,sram = &sram0;
		zephyr,flash = &flash0;
	};
};
